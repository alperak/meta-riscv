## conf/machine/beaglev-ahead.conf
```bitbake
#@TYPE: Machine
#@NAME: beaglev-ahead
#@SOC: Xuantie C910
#@DESCRIPTION: Machine configuration for the Beagle-V Ahead board

require include/c910.inc

# Extend the list from riscv-common.inc
MACHINE_FEATURES += "usb wifi bluetooth"

#============================================
# SBI Configuration
#RISCV_SBI_FDT ?= "th1520-beaglev-ahead.dtb"
unset RISCV_SBI_PAYLOAD
#============================================

#============================================
# Kernel Configuration
KERNEL_DEVICETREE ?= "thead/th1520-beaglev-ahead.dtb"
KERNEL_IMAGETYPE = "Image"
#============================================

#============================================
# Uboot Configuration
UBOOT_MACHINE = "th1520_beaglev_ahead_defconfig"
UBOOT_ENV = ""
#============================================

#============================================
# Firmware Configuration
TH1520_TRAINING_FW_SRC = "lpddr4x-3733-singlerank.lua"
#============================================

#============================================
# Image Configuration
# Note: currently just a fastboot deployment is supported
#       for which a separate boot.ext4 is generated
IMAGE_BOOT_FILES = " \
    ${KERNEL_IMAGETYPE} \
    fw_payload.bin \
    th1520-beaglev-ahead.dtb \
    extlinux.conf;extlinux/extlinux.conf \
"
WKS_FILE ?= "beaglev-ahead.wks"
#============================================

#============================================
# Common Preferred Providers
PREFERRED_PROVIDER_virtual/kernel ?= "linux-mainline"
PREFERRED_PROVIDER_virtual/bootloader ?= "u-boot"
PREFERRED_PROVIDER_opensbi ?= "opensbi"
EXTRA_IMAGEDEPENDS += "u-boot firmware-th1520"
#============================================
WKS_FILE_DEPENDS:append = " gptfdisk-native"
```
